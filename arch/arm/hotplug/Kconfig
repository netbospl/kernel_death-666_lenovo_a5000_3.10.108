## arch/arm/hotplug/Kconfig
```kconfig
config THUNDERPLUG_CONTROL
	bool "Enable plugging down/up of cores based on load per core"
	help
	  This driver hotplugs cpu cores based on per-core load

config ALUCARD_HOTPLUG
	bool "Enable alucard-hotplug cpu hotplug driver"
	default n
	help
	  Generic Alucard-hotplug cpu hotplug driver for ARM SOCs

config ASMP
	bool "Multi-core automatic hotplug support"
	depends on SMP
	default n
	help
	  Automatically hotplugs the multiple cpu cores on and off
	  based on cpu load and suspend state
```
